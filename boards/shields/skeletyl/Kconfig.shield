## boards/shields/skeletyl/Kconfig.shield
```kconfig
# Copyright (c) 2025 Ethan Moss
# SPDX-License-Identifier: MIT

config SHIELD_SKELETYL_LEFT
    def_bool $(shields_list_contains,skeletyl_left)

config SHIELD_SKELETYL_RIGHT
    def_bool $(shields_list_contains,skeletyl_right)
```
